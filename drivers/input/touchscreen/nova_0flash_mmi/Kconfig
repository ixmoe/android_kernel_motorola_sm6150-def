## drivers/input/touchscreen/nova_0flash_mmi/Kconfig
```kconfig
#
# Novatek NT36xxx no flash touchscreen driver configuration
#
config TOUCHSCREEN_NT36xxx_HOSTDL_SPI_MMI
	tristate "Novatek NT36xxx host download SPI driver"
	default n
	help
	  Say Y here if you have a Novatek NT36xxx no flash touchscreen connected
	  to your system by SPI bus.

	  If unsure, say N.

config INPUT_NOVA_0FLASH_MMI_ENABLE_DOUBLE_TAP
	bool "Novatek NT36xxx Doubel tap"
	depends on TOUCHSCREEN_NT36xxx_HOSTDL_SPI_MMI
	default n
	help
	  Say Y here if you want to have Double tap support on Novatek NT36xxx.

	  If unsure, say N.
```
